## conf/layer.conf
```bitbake
# We have a conf and classes directory, append to BBPATH
BBPATH .= ":${LAYERDIR}"

# We have a recipes directory, add to BBFILES
BBFILES += "${LAYERDIR}/recipes*/*/*.bb \
            ${LAYERDIR}/recipes*/*/*.bbappend \ 
            ${LAYERDIR}/recipes*/*/*/*.bbappend \ 
            ${LAYERDIR}/images/*.bb \
            "

BBFILE_COLLECTIONS += "meta-geophone"
BBFILE_PATTERN_meta-geophone := "^${LAYERDIR}/"
BBFILE_PRIORITY_meta-geophone = "16"

LAYERSERIES_COMPAT_meta-geophone = "hardknott honister"
```
